## conf/bblayers.conf
```bitbake
# POKY_BBLAYERS_CONF_VERSION is increased each time build/conf/bblayers.conf
# changes incompatibly
POKY_BBLAYERS_CONF_VERSION = "2"

BBPATH = "${TOPDIR}"
BBFILES ?= ""

BBLAYERS ?= " \
  ${REPO_ROOT}/poky/meta \
  ${REPO_ROOT}/poky/meta-poky \
  ${REPO_ROOT}/meta-openembedded/meta-oe \
  ${REPO_ROOT}/meta-openembedded/meta-python \
  ${REPO_ROOT}/meta-openembedded/meta-multimedia \
  ${REPO_ROOT}/meta-raspberrypi \
  ${REPO_ROOT}/meta-clang \
  ${REPO_ROOT}/meta-flutter \
  "
```

## meta-machine-control/conf/layer.conf
```bitbake
# We have a conf and classes directory, add to BBPATH
BBPATH .= ":${LAYERDIR}"

# We have recipes-* directories, add to BBFILES
BBFILES += "${LAYERDIR}/recipes-*/*/*.bb \
            ${LAYERDIR}/recipes-*/*/*.bbappend \
            "

BBFILE_COLLECTIONS += "machine-control"
BBFILE_PATTERN_machine-control = "^${LAYERDIR}/"
BBFILE_PRIORITY_machine-control = "5"

LAYERDEPENDS_machine-control = "core \
    flutter-layer \
    raspberrypi \
    "

LAYERSERIES_COMPAT_machine-control = "scarthgap"

# Set the Flutter SDK version that will be used when this layer is included.
FLUTTER_SDK_TAG = "3.24.0"

# Only support release Flutter builds.
PACKAGECONFIG:remove:pn-flutter-engine = " debug profile"
```
